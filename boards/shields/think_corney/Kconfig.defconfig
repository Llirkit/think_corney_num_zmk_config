## boards/shields/think_corney/Kconfig.defconfig
```kconfig
if SHIELD_THINK_CORNEY_RIGHT
# Name must be less than 16 characters long!
config ZMK_KEYBOARD_NAME
    default "ThinkCorney"

config ZMK_SPLIT_ROLE_CENTRAL
    default y
endif

if SHIELD_THINK_CORNEY_LEFT || SHIELD_THINK_CORNEY_RIGHT
config ZMK_SPLIT
    default y
endif
```

## boards/shields/think_corney/Kconfig.shield
```kconfig
config SHIELD_THINK_CORNEY_LEFT
    def_bool $(shields_list_contains,think_corney_left)

config SHIELD_THINK_CORNEY_RIGHT
    def_bool $(shields_list_contains,think_corney_right)
```

## boards/shields/think_corney_num/Kconfig.defconfig
```kconfig
if ZMK_KEYBOARD_THINK_CORNEY
config ZMK_SPLIT
    default y
endif

# Split role: TrackPoint is on the RIGHT half, so make RIGHT the central
if ZMK_SHIELD_THINK_CORNEY_RIGHT
config ZMK_SPLIT_ROLE_CENTRAL
    default y
endif
```

## boards/shields/think_corney_num/Kconfig.shield
```kconfig
config ZMK_KEYBOARD_THINK_CORNEY
    bool "think_corney keyboard"
    default y

config ZMK_SHIELD_THINK_CORNEY_LEFT
    bool "think_corney left"
    select ZMK_KEYBOARD_THINK_CORNEY

config ZMK_SHIELD_THINK_CORNEY_RIGHT
    bool "think_corney right"
    select ZMK_KEYBOARD_THINK_CORNEY
```

## config/west.yml
```yaml
manifest:
  remotes:
    - name: zmkfirmware
      url-base: https://github.com/zmkfirmware
    - name: infused-kim
      url-base: https://github.com/infused-kim
    - name: petejohanson
      url-base: https://github.com/petejohanson
    - name: urob
      url-base: https://github.com/urob

  projects:
    - name: zmk
      remote: zmkfirmware
      revision: v0.3.0
      import: app/west.yml

    # PS/2 mouse / TrackPoint module
    - name: kb_zmk_ps2_mouse_trackpoint_driver
      remote: infused-kim
      revision: main

    # Auto-layer module required for &num_word when HAS_UROB is enabled
    - name: zmk-auto-layer
      remote: urob
      revision: main

    # Fallback if the PS/2 module breaks against upstream main again:
    # - name: zmk
    #   remote: infused-kim
    #   revision: pr-testing/mouse_ps2_module_base
    #   import: app/west.yml

  self:
    path: config
```
