#include "think_corney.dtsi"

/ {
  compatible = "zmk,keyboard-think-corney-left";
};

/* nice!view SPI:
   DPD=P2 (MOSI)
   DPC=P3 (SCK)
   DPE=P9 (CS) */
&default_transform {
  col-offset = <0>;
};
