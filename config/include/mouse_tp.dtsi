#ifdef HAS_MOUSE_TP
#include <dt-bindings/zmk/mouse.h>
#include <dt-bindings/zmk/keys.h>
#include <dt-bindings/zmk/outputs.h>
#include <dt-bindings/zmk/bt.h>

/* Key behaviors to adjust settings */
#define U_MSS_TP_S_I &mms MS_TP_SENSITIVITY_INCR
#define U_MSS_TP_S_D &mms MS_TP_SENSITIVITY_DECR
#define U_MSS_TP_V6_I &mms MS_TP_VALUE6_INCR
#define U_MSS_TP_V6_D &mms MS_TP_VALUE6_DECR
#define U_MSS_TP_NI_I &mms MS_TP_NEG_INERTIA_INCR
#define U_MSS_TP_NI_D &mms MS_TP_NEG_INERTIA_DECR
#define U_MSS_TP_PT_I &mms MS_TP_PTS_THRESHOLD_INCR
#define U_MSS_TP_PT_D &mms MS_TP_PTS_THRESHOLD_DECR
#define U_MSS_RESET &mms MS_RESET
#define U_MSS_LOG &mms MS_LOG

#ifdef MOUSE_PS2_DT_PRESENT
&mouse_ps2_input_listener {
    layer-toggle = <3>;
    layer-toggle-delay-ms = <250>;
    layer-toggle-timeout-ms = <250>;
};

&mouse_ps2 {
    /* tp-sensitivity = <128>; */
    /* tp-neg-inertia = <6>; */
    /* sampling-rate = <60>; */
};

&mouse_ps2 { status = "okay"; };
&mouse_ps2_input_listener { status = "okay"; };
&uart0 { status = "okay"; };
&uart_ps2 { status="okay"; };
#endif /* MOUSE_PS2_DT_PRESENT */
#endif /* HAS_MOUSE_TP */
