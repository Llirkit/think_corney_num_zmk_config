#include "think_corney.dtsi"

&kscan0 {
    col-gpios = <&gpio0 24 GPIO_ACTIVE_LOW>, /* C0 */
            <&gpio1 0  GPIO_ACTIVE_LOW>, /* C1 */
            <&gpio0 11 GPIO_ACTIVE_LOW>, /* C2 */
            <&gpio1 4  GPIO_ACTIVE_LOW>, /* C3 */
            <&gpio1 6  GPIO_ACTIVE_LOW>, /* C4 */
            <&gpio0 9  GPIO_ACTIVE_LOW>; /* C5 */
};

/* Left half; shift its columns by 6 in the composite matrix */
&default_transform {
    col-offset = <6>;
};
